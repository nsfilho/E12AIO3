## main/Kconfig.projbuild
```kconfig
menu "E12AIO3 Config"

menu "Available Components"
    config COMPONENT_HTTPD
        bool "Enable HTTPD Component"
        default true
        help
            Active the HTTPD component. Specially used to configure board.

    config COMPONENT_MQTT
        bool "Enable MQTT Component"
        default true
        help
            Active the MQTT control component.

    config COMPONENT_RELAY
        bool "Enable Relay Component"
        default true
        help
            Active the relay control component.
    config COMPONENT_OTA
        bool "Enable OTA Component"
        default false
        help
            Active the OTA control component / tasks.
    config COMPONENT_DEBUG
        bool "Enable Debug Component"
        default false
        help
            Active the debug control component / tasks.
endmenu

menu "Config Component"
    config JSON_BUFFER_SIZE
        int "JSON Buffer Size (bytes)"
        default 512
        help
            Size of json buffer to manipulate config file.

    config SAVE_LAZY_TIMEOUT
        int "Waiting time to save config (ms)"
        default 30000
        help
            Time to wait before save configuration in miliseconds. This is important
            because avoid to write many times the configuration for quickly changes.
endmenu

menu "WIFI Component"
    config WIFI_SSID
        string "Default WIFI SSID"
        default "myssid"
        help
            SSID (network name) as default fabric configuration.

    config WIFI_PASSWORD
        string "Default WIFI Password"
        default "mypassword"
        help
            WIFI password (WPA or WPA2) as default fabric configuration.

    config WIFI_AP_PASSWORD
        string "WiFi Recovery Network Password"
        default "password"
        help
            WiFi password used in recovery network
    
    config WIFI_AP_MAX_STA_CONN
        int "WiFi AP Max Simultaneous Connection"
        default 4
        help
            Maximum simultaneons connections to SoftAP mode to recovery.
            Important: maximum supported is 4.
    
    config WIFI_SCAN_RETRY
        int "WiFi Rescan Timeout (ms)"
        default 30000
        help
            This configuration permits you to define the time between scans for know
            networks to retry connections (when droped).
    
    config WIFI_SCAN_MAX_NETWORKS
        int "WiFi max networks to retrieve in scan"
        default 20
        help
            Maximum number os records to return after a network scan to verify if exists
            any knows network.
            
endmenu 

menu "MQTT Component"
    config MQTT_URL
        string "MQTT URL"
        default "mqtt://user:pass@iot.eclipse.org:1883"
        help
            URL of the broker to connect to
    
    config MQTT_TOPIC_BASE
        string "MQTT Base for default topic"
        default "home/"
        help
            Base for default topic, which is concatenate with ESP Name. It is important
            to remember to put a slash (/) at the end.
    
    config MQTT_TOPIC_SIZE
        int "Max topic size"
        default 70
        help
            Max topic size name
    
    config MQTT_PAYLOAD_SIZE
        int "Max payload size"
        default 200
        help
            Max payload size name

    config MQTT_RETRY_TIMEOUT
        int "MQTT Retry (ms)"
        default 60000
        help
            Number of seconds to retry connect with MQTT
    
    config MQTT_KEEPALIVE_TIMEOUT
        int "MQTT Keep Alive (ms)"
        default 120000
        help
            Number of miliseconds to send keep alive
    
    config MQTT_DELAY_RUSH_PACKAGE
        int "MQTT Delay for publish rush (ms)"
        default 200
        help
            Numer of miliseconds to wait before send another package.    
endmenu

menu "HTTPD Component"
    config WEB_AUTH_USERNAME
        string "Web Auth Username"
        default "admin"
        help
            Web authentication username.

    config WEB_AUTH_PASSWORD
        string "Web Auth Password"
        default "password"
        help
            Web authentication password.

    config WEB_TOKEN
        string "Token for API"
        default "87654321"
        help
            Token key used in API call.

    config WEB_AUTH_MAX_SIZE
        int "Max size for username, password and token"
        default 24
        help
            Max size for username, password and token buffers.
    config WEB_WAIT_BEFORE_RESTART
        int "Waiting time before restart esp (ms)"
        default 5000
        help
            Waiting time, when received a restart event before do. This parameter
            give time to response for http client before restart.
endmenu

menu "Relay Component"
    config RELAY_PORT1
        int "Relay Port 1 GPIO"
        default 14
        help
            GPIO port for relay 1.
    config RELAY_PORT2
        int "Relay Port 2 GPIO"
        default 12
        help
            GPIO port for relay 2.
    config RELAY_PORT3
        int "Relay Port 3 GPIO"
        default 13
        help
            GPIO port for relay 3.        
endmenu

menu "OTA Component"
    config OTA_WATCHDOG_TIMEOUT
        int "Watchdog Timeout (ms)"
        default 300000
        help
            Web authentication username.
    config OTA_LOCAL_CERTIFICATE
        bool "Embed a local certificate"
        default false
        help
            Add a local certificate file ota/certs/ca_cert.pem to binary
endmenu

menu "Debug Component"
    config DEBUG_INFO_DELAY
        int "Delay for print information (ms)"
        default 2000
        help
            Numer of miliseconds to wait before send another block of info to serial. 
endmenu

endmenu
```

## sdkconfig.defaults
```kconfig
#
# E12AIO3 Firmware
# Copyright (C) 2020 E01-AIO Automação Ltda.
# 
# This program is free software: you can redistribute it and/or modify
# it under the terms of the GNU General Public License as published by
# the Free Software Foundation, either version 3 of the License, or
# (at your option) any later version.
#
# This program is distributed in the hope that it will be useful,
# but WITHOUT ANY WARRANTY; without even the implied warranty of
# MERCHANTABILITY or FITNESS FOR A PARTICULAR PURPOSE.  See the
# GNU General Public License for more details.
# 
# You should have received a copy of the GNU General Public License
# along with this program.  If not, see <http://www.gnu.org/licenses/>.
# 
# Author: Nelio Santos <nsfilho@icloud.com>
# Repository: https://github.com/nsfilho/E12AIO3
#

CONFIG_COMPONENT_HTTPD=y
CONFIG_COMPONENT_MQTT=y
CONFIG_COMPONENT_RELAY=y
CONFIG_COMPONENT_OTA=y


# ESP Configs
CONFIG_ESP8266_DEFAULT_CPU_FREQ_160=y
CONFIG_ESP8266_DEFAULT_CPU_FREQ_MHZ=160

# Configure Basic Monitors
CONFIG_CONSOLE_UART_DEFAULT=y
CONFIG_CONSOLE_UART_BAUDRATE=74880
CONFIG_ESPTOOLPY_MONITOR_BAUD_OTHER_VAL=74880
CONFIG_ESPTOOLPY_MONITOR_BAUD=74880
CONFIG_ESPTOOLPY_MONITOR_BAUD_74880B=y

# ESP IDF Configs
CONFIG_PARTITION_TABLE_CUSTOM=y
CONFIG_PARTITION_TABLE_CUSTOM_FILENAME="partitions.csv"
CONFIG_PARTITION_TABLE_FILENAME="partitions.csv"
CONFIG_MQTT_USING_ESP=y
CONFIG_LWIP_NETIF_LOOPBACK=y
CONFIG_LWIP_LOOPBACK_MAX_PBUFS=1
CONFIG_USING_SPIFFS=y
CONFIG_SPIFFS_MAX_PARTITIONS=3
CONFIG_SPIFFS_CACHE=y
CONFIG_SPIFFS_CACHE_WR=y
CONFIG_SPIFFS_PAGE_CHECK=y
CONFIG_SPIFFS_GC_MAX_RUNS=10
CONFIG_SPIFFS_PAGE_SIZE=256
CONFIG_SPIFFS_OBJ_NAME_LEN=32
CONFIG_SPIFFS_USE_MAGIC=y
CONFIG_SPIFFS_USE_MAGIC_LENGTH=y
CONFIG_SPIFFS_META_LENGTH=4
CONFIG_SPIFFS_USE_MTIME=y
CONFIG_LWIP_NETIF_LOOPBACK=y
CONFIG_LWIP_LOOPBACK_MAX_PBUFS=1
CONFIG_NEWLIB_LIBRARY_LEVEL_NORMAL=y

# MBED Config
CONFIG_ESP_TLS_USING_MBEDTLS=y
CONFIG_MBEDTLS_DEFAULT_MEM_ALLOC=y
CONFIG_MBEDTLS_ASYMMETRIC_CONTENT_LEN=y
CONFIG_MBEDTLS_SSL_IN_CONTENT_LEN=16384
CONFIG_MBEDTLS_SSL_OUT_CONTENT_LEN=1024
```
